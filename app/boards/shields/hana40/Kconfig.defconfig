## app/boards/shields/hana40/Kconfig.defconfig
```kconfig
# Copyright (c) 2020 The ZMK Contributors
# SPDX-License-Identifier: MIT

if SHIELD_HANA40

config ZMK_KEYBOARD_NAME
    default "Hana40"

config SPI
	default y

endif
```
